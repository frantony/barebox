## arch/riscv/configs/qemu-sifive-u500_defconfig
```kconfig
CONFIG_MACH_SIFIVE=y
CONFIG_ARCH_RV64I=y
CONFIG_64BIT=y
CONFIG_BUILTIN_DTB=y
CONFIG_BUILTIN_DTB_NAME="qemu-sifive_u"
# CONFIG_GLOBALVAR is not set
CONFIG_TEXT_BASE=0x80000000
CONFIG_MEMORY_LAYOUT_FIXED=y
CONFIG_STACK_BASE=0x807f0000
CONFIG_STACK_SIZE=0x10000
CONFIG_MALLOC_BASE=0x80800000
CONFIG_HUSH_FANCY_PROMPT=y
CONFIG_CMDLINE_EDITING=y
CONFIG_AUTO_COMPLETE=y
# CONFIG_BOOTM is not set
CONFIG_PARTITION=y
# CONFIG_ENV_HANDLING is not set
CONFIG_DEFAULT_COMPRESSION_GZIP=y
CONFIG_DEBUG_LL=y
CONFIG_CMD_DMESG=y
CONFIG_LONGHELP=y
CONFIG_CMD_IOMEM=y
CONFIG_CMD_IMD=y
CONFIG_CMD_MEMINFO=y
CONFIG_CMD_GO=y
CONFIG_CMD_RESET=y
CONFIG_CMD_UIMAGE=y
CONFIG_CMD_PARTITION=y
CONFIG_CMD_AUTOMOUNT=y
CONFIG_CMD_EXPORT=y
CONFIG_CMD_DEFAULTENV=y
CONFIG_CMD_PRINTENV=y
CONFIG_CMD_MAGICVAR=y
CONFIG_CMD_MAGICVAR_HELP=y
CONFIG_CMD_BASENAME=y
CONFIG_CMD_CMP=y
CONFIG_CMD_DIRNAME=y
CONFIG_CMD_FILETYPE=y
CONFIG_CMD_LN=y
CONFIG_CMD_MD5SUM=y
CONFIG_CMD_READLINK=y
CONFIG_CMD_SHA1SUM=y
CONFIG_CMD_SHA224SUM=y
CONFIG_CMD_SHA256SUM=y
CONFIG_CMD_SHA384SUM=y
CONFIG_CMD_SHA512SUM=y
CONFIG_CMD_UNCOMPRESS=y
CONFIG_CMD_GETOPT=y
CONFIG_CMD_LET=y
CONFIG_CMD_MSLEEP=y
CONFIG_CMD_READF=y
CONFIG_CMD_SLEEP=y
CONFIG_CMD_ECHO_E=y
CONFIG_CMD_EDIT=y
CONFIG_CMD_READLINE=y
CONFIG_CMD_TIMEOUT=y
CONFIG_CMD_CRC=y
CONFIG_CMD_CRC_CMP=y
CONFIG_CMD_MM=y
CONFIG_CMD_CLK=y
CONFIG_CMD_DETECT=y
CONFIG_CMD_OF_NODE=y
CONFIG_CMD_OF_PROPERTY=y
CONFIG_CMD_OF_DISPLAY_TIMINGS=y
CONFIG_CMD_OFTREE=y
CONFIG_CMD_TIME=y
CONFIG_OFDEVICE=y
CONFIG_DRIVER_SERIAL_SIFIVE=y
# CONFIG_SPI is not set
# CONFIG_PINCTRL is not set
CONFIG_FS_BPKFS=y
CONFIG_FS_UIMAGEFS=y
CONFIG_ZLIB=y
CONFIG_BZLIB=y
CONFIG_LZ4_DECOMPRESS=y
CONFIG_XZ_DECOMPRESS=y
CONFIG_LZO_DECOMPRESS=y
CONFIG_DIGEST_HMAC_GENERIC=y
```

## arch/riscv/mach-sifive/Kconfig
```kconfig
if MACH_SIFIVE

config ARCH_TEXT_BASE
	hex
	default 0x00001000

choice
	prompt "Board type"

config BOARD_QEMU_SIFIVE_U
	bool "qemu sifive_u"
	select HAS_DEBUG_LL

endchoice

endif
```

## arch/sandbox/configs/sandbox_defconfig
```kconfig
CONFIG_HUSH_FANCY_PROMPT=y
CONFIG_CMDLINE_EDITING=y
CONFIG_AUTO_COMPLETE=y
CONFIG_PARTITION=y
CONFIG_DEFAULT_ENVIRONMENT_PATH="arch/sandbox/board/env"
CONFIG_POLLER=y
CONFIG_DEBUG_INFO=y
CONFIG_LONGHELP=y
CONFIG_CMD_MEMINFO=y
# CONFIG_CMD_BOOTM is not set
CONFIG_CMD_GO=y
CONFIG_CMD_RESET=y
CONFIG_CMD_PARTITION=y
CONFIG_CMD_EXPORT=y
CONFIG_CMD_PRINTENV=y
CONFIG_CMD_MAGICVAR=y
CONFIG_CMD_MAGICVAR_HELP=y
CONFIG_CMD_SAVEENV=y
CONFIG_CMD_SHA1SUM=y
CONFIG_CMD_SLEEP=y
CONFIG_CMD_EDIT=y
CONFIG_CMD_READLINE=y
CONFIG_CMD_TIMEOUT=y
CONFIG_CMD_CRC=y
CONFIG_CMD_FLASH=y
CONFIG_CMD_2048=y
CONFIG_CMD_OF_NODE=y
CONFIG_CMD_OF_PROPERTY=y
CONFIG_CMD_OF_DISPLAY_TIMINGS=y
CONFIG_CMD_OFTREE=y
CONFIG_NET=y
CONFIG_OFDEVICE=y
CONFIG_OF_BAREBOX_DRIVERS=y
CONFIG_DRIVER_NET_TAP=y
# CONFIG_SPI is not set
# CONFIG_PINCTRL is not set
CONFIG_FS_CRAMFS=y
CONFIG_FS_TFTP=y
CONFIG_DIGEST_SHA1_GENERIC=y
CONFIG_NET_PICOTCP=y
CONFIG_NET_PICO_SUPPORT_IPV4=y
CONFIG_NET_PICO_SUPPORT_ICMP4=y
CONFIG_NET_PICO_SUPPORT_DHCP_CLIENT=y
CONFIG_NET_PICO_SUPPORT_TCP=y
CONFIG_NET_PICO_SUPPORT_UDP=y
CONFIG_NET_PICO_SUPPORT_ETH=y
CONFIG_NET_PICO_SUPPORT_DEVLOOP=y
```

## drivers/clocksource/Kconfig
```kconfig
config AMBA_SP804
	bool
	depends on ARM_AMBA

config ARM_SMP_TWD
	bool
	depends on ARM && CPU_V7

config CLOCKSOURCE_BCM2835
	bool
	depends on ARCH_BCM2835

config CLOCKSOURCE_CLPS711X
	bool
	depends on ARCH_CLPS711X

config CLOCKSOURCE_DUMMY
	bool "Enable dummy software-only clocksource"
	default n

config CLOCKSOURCE_DUMMY_RATE
	int "compile loglevel"
	depends on CLOCKSOURCE_DUMMY
	default 1000

config CLOCKSOURCE_MVEBU
	bool
	depends on ARCH_MVEBU

config CLOCKSOURCE_NOMADIK
	bool
	depends on ARM

config CLOCKSOURCE_ORION
	bool
	depends on ARCH_MVEBU
```

## drivers/pci/Kconfig
```kconfig
#
# PCI configuration
#
config PCI_DEBUG
	bool "PCI Debugging"
	depends on PCI
	help
	  Say Y here if you want the PCI core to produce a bunch of debug
	  messages to the system log.  Select this if you are having a
	  problem with PCI support and want to see more of what is going on.

	  When in doubt, say N.
```

## net/Kconfig
```kconfig
menuconfig NET
	bool "Networking Support"

if NET

choice
	prompt "network stack implementation"

config NET_LEGACY
	bool "legacy U-Boot network stack"

config NET_PICOTCP
	bool "picotcp network stack"
	select POLLER

endchoice

config NET_NFS
	bool
	prompt "nfs support"

config NET_NETCONSOLE
	bool
	depends on !CONSOLE_NONE
	prompt "network console support"
	help
	  This option adds support for a simple udp based network console.

config NET_RESOLV
	bool
	prompt "dns support"

config NET_IFUP
	default y
	depends on NET_LEGACY
	bool

config NET_DHCP
	bool
	depends on NET_LEGACY
	prompt "dhcp support"

source "net/picotcp/Kconfig"

endif
```

## net/picotcp/Kconfig
```kconfig
config NET_PICOTCP
	bool "picotcp network stack"
	select POLLER

if NET_PICOTCP

config NET_PICO_SUPPORT_IPV4
	bool
	default y

config NET_PICO_SUPPORT_ICMP4
	bool
	default y if NET_PICO_SUPPORT_IPV4

config NET_PICO_SUPPORT_UDP
	bool
	default y if NET_PICO_SUPPORT_IPV4

config NET_PICO_SUPPORT_TCP
	bool
	default y if NET_PICO_SUPPORT_IPV4

config NET_PICO_SUPPORT_ETH
	bool
	default y

config NET_PICO_SUPPORT_DEVLOOP
	bool
	default y

config NET_PICO_SUPPORT_DHCP_CLIENT
	bool
	default y

config NET_PICO_SUPPORT_DNS_CLIENT
	bool
	default y

comment "Commands"

config CMD_PICOTCP_TEST_IPV4
	bool
	depends on NET_PICO_SUPPORT_IPV4
	prompt "test_picotcp command"

config CMD_PICOTCP_IFCONFIG
	bool
	depends on NET_PICO_SUPPORT_IPV4
	prompt "ifconfig command"

config CMD_PICOTCP_ROUTE
	bool
	depends on NET_PICO_SUPPORT_IPV4
	prompt "route command"

config CMD_PICOTCP_DHCLIENT
	bool
	depends on NET_PICO_SUPPORT_UDP
	select NET_PICO_SUPPORT_DHCP_CLIENT
	prompt "dhclient command"

endif # NET_PICOTCP
```
