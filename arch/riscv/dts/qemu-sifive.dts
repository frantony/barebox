/dts-v1/;

#include "skeleton.dtsi"

/ {
	model = "QEMU MIET board";
	compatible = "miet,qemu";

	memory {
		device_type = "memory";
		reg = <0 0x80000000 0x00800000>;
	};

	uart: uart {
		compatible = "ns16550a";
		reg = <0 0x90000000 0x20>;
		reg-shift = <2>;
		clock-frequency = <24000000>;
	};
};
