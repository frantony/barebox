#include "erizo.dtsi"
#include <dt-bindings/gpio/gpio.h>

/ {
	model = "generic Erizo SoC board";
	compatible = "miet-riscv-workgroup,erizo-generic-board";

	memory {
		device_type = "memory";
		reg = <0x80000000 0x00800000>;
	};
};
