## arch/mips/mach-ralink/Kconfig
```kconfig
if MACH_MIPS_RALINK

config DEBUG_LL_RT2880
	bool "debug_ll for rt2880-style uart port"
	depends on DEBUG_LL

config BOARD_WRTNODE2R
	bool "WRTnode2R"
	select HAVE_PBL_IMAGE
	select HAVE_IMAGE_COMPRESSION
	select HAS_NMON

config BOARD_LINKIT
	bool "Linkit Smart 7688"
	select HAVE_PBL_IMAGE
	select HAVE_IMAGE_COMPRESSION
	select HAS_NMON

config BOARD_OMEGA2
	bool "Onion Omega2"
	select HAVE_PBL_IMAGE
	select HAVE_IMAGE_COMPRESSION
	select HAS_NMON

config BOARD_WRTNODE
	bool "WRTnode"
	select DEBUG_LL_RT2880

endif
```

## arch/mips/mach-xburst/Kconfig
```kconfig
if MACH_MIPS_XBURST

config ARCH_TEXT_BASE
	hex
	default 0xa0800000

config CPU_JZ4755
	bool

config CPU_JZ4770
	bool

choice
	prompt "Board type"

config BOARD_RZX50
	bool "Ritmix RZX-50"
	select HAS_POWEROFF
	select CPU_JZ4755
	select HAVE_PBL_IMAGE
	select HAVE_IMAGE_COMPRESSION

config BOARD_AINOL_NOVO7_PALADIN
	bool "Ainol Novo7 Paladin"
	select CPU_JZ4770

endchoice

source arch/mips/boards/rzx50/Kconfig
source arch/mips/boards/ainol-novo7-paladin/Kconfig

endif
```

## arch/riscv/Kconfig
```kconfig
config RISCV
	bool
	select GENERIC_FIND_NEXT_BIT
	select HAVE_CONFIGURABLE_MEMORY_LAYOUT
	select HAVE_CONFIGURABLE_TEXT_BASE
	select GPIOLIB
	select OFTREE
	select COMMON_CLK
	select COMMON_CLK_OF_PROVIDER
	select CLKDEV_LOOKUP
	default y

config ARCH_TEXT_BASE
	hex
	default 0x0

config GENERIC_LINKER_SCRIPT
	bool
	default y

menu "Machine selection"

choice
	prompt "System type"
	default MACH_ERIZO

config MACH_ERIZO
	bool "erizo family"
	select HAS_DEBUG_LL

endchoice

choice
	prompt "CPU selection"
	default CPU_RV_GENERIC

config CPU_RV_GENERIC
	bool "Generic RISC-V"
	select CPU_SUPPORTS_32BIT_KERNEL
	select CPU_SUPPORTS_64BIT_KERNEL

endchoice

config CPU_SUPPORTS_32BIT_KERNEL
	bool
config CPU_SUPPORTS_64BIT_KERNEL
	bool

choice
	prompt "barebox code model"
	default 64BIT

config 32BIT
	bool "32-bit barebox"
	depends on CPU_SUPPORTS_32BIT_KERNEL
	help
	  Select this option to build a 32-bit barebox.

config 64BIT
	bool "64-bit barebox"
	depends on CPU_SUPPORTS_64BIT_KERNEL
	help
	  Select this option to build a 64-bit barebox.

endchoice

config BUILTIN_DTB
	bool "link a DTB into the barebox image"
	depends on OFTREE

config BUILTIN_DTB_NAME
	string "DTB to build into the barebox image"
	depends on BUILTIN_DTB

source arch/riscv/mach-erizo/Kconfig

endmenu

menu "RISC-V specific settings"

config HAS_NMON
	bool

config NMON
	bool "nmon"
	depends on HAS_NMON
	depends on DEBUG_LL
	help
	  Say yes here to add the nmon to pbl.
	  nmon -- nano-monitor program for the RISC-V processors.
	  It can operate with NO working RAM, using only
	  the processor registers.

config NMON_HELP
	bool "nmon help message"
	depends on NMON
	help
	  Say yes here to get the nmon commands message on
	  every nmon start.

endmenu

source common/Kconfig
source commands/Kconfig
source net/Kconfig
source drivers/Kconfig
source fs/Kconfig
source lib/Kconfig
source crypto/Kconfig
```

## arch/riscv/configs/erizo_memtest_from_sram_defconfig
```kconfig
# CONFIG_BANNER is not set
# CONFIG_MEMINFO is not set
CONFIG_TEXT_BASE=0x40000000
CONFIG_BAREBOX_MAX_IMAGE_SIZE=0x2000
CONFIG_MEMORY_LAYOUT_FIXED=y
CONFIG_STACK_BASE=0x40003800
CONFIG_STACK_SIZE=0x0800
CONFIG_MALLOC_BASE=0x40002000
CONFIG_MALLOC_SIZE=0x1800
CONFIG_MALLOC_DUMMY=y
CONFIG_SHELL_NONE=y
# CONFIG_ERRNO_MESSAGES is not set
# CONFIG_TIMESTAMP is not set
CONFIG_CONSOLE_SIMPLE=y
CONFIG_DEBUG_LL=y
# CONFIG_SPI is not set
CONFIG_CLOCKSOURCE_DUMMY_RATE=60000
# CONFIG_FS_RAMFS is not set
# CONFIG_FS_DEVFS is not set
```

## arch/riscv/configs/qemu-miet_defconfig
```kconfig
CONFIG_32BIT=y
CONFIG_BUILTIN_DTB=y
CONFIG_BUILTIN_DTB_NAME="qemu-sifive"
# CONFIG_GLOBALVAR is not set
CONFIG_TEXT_BASE=0x80000000
CONFIG_MEMORY_LAYOUT_FIXED=y
CONFIG_STACK_BASE=0x80200000
CONFIG_STACK_SIZE=0x80000
CONFIG_MALLOC_BASE=0x80280000
CONFIG_MALLOC_SIZE=0x80000
CONFIG_MALLOC_TLSF=y
CONFIG_PANIC_HANG=y
CONFIG_HUSH_FANCY_PROMPT=y
# CONFIG_ERRNO_MESSAGES is not set
# CONFIG_TIMESTAMP is not set
# CONFIG_BOOTM is not set
# CONFIG_ENV_HANDLING is not set
CONFIG_POLLER=y
CONFIG_DEBUG_LL=y
CONFIG_DEBUG_INITCALLS=y
CONFIG_LONGHELP=y
CONFIG_CMD_IOMEM=y
CONFIG_CMD_MEMINFO=y
CONFIG_CMD_GO=y
CONFIG_CMD_LOADY=y
# CONFIG_CMD_CD is not set
# CONFIG_CMD_CP is not set
# CONFIG_CMD_MKDIR is not set
# CONFIG_CMD_PWD is not set
# CONFIG_CMD_RM is not set
# CONFIG_CMD_RMDIR is not set
# CONFIG_CMD_FALSE is not set
CONFIG_CMD_SLEEP=y
# CONFIG_CMD_TRUE is not set
# CONFIG_CMD_CLEAR is not set
# CONFIG_CMD_ECHO is not set
CONFIG_CMD_MM=y
CONFIG_OFDEVICE=y
CONFIG_DRIVER_SERIAL_NS16550=y
# CONFIG_SPI is not set
CONFIG_CLOCKSOURCE_DUMMY_RATE=60000
# CONFIG_PINCTRL is not set
```

## arch/riscv/configs/qemu-miet_memtest_defconfig
```kconfig
CONFIG_32BIT=y
CONFIG_BUILTIN_DTB=y
CONFIG_BUILTIN_DTB_NAME="qemu-sifive"
# CONFIG_BANNER is not set
# CONFIG_MEMINFO is not set
CONFIG_TEXT_BASE=0x80000000
CONFIG_MEMORY_LAYOUT_FIXED=y
CONFIG_STACK_BASE=0x80038000
CONFIG_MALLOC_BASE=0x80030000
CONFIG_MALLOC_SIZE=0x8000
CONFIG_MALLOC_DUMMY=y
CONFIG_SHELL_NONE=y
# CONFIG_ERRNO_MESSAGES is not set
# CONFIG_TIMESTAMP is not set
CONFIG_CONSOLE_SIMPLE=y
CONFIG_DEBUG_LL=y
# CONFIG_SPI is not set
CONFIG_CLOCKSOURCE_DUMMY_RATE=60000
# CONFIG_FS_RAMFS is not set
# CONFIG_FS_DEVFS is not set
```
