## arch/arm/boards/canon-600d/Kconfig
```kconfig
if MACH_CANON_600D

config ARCH_TEXT_BASE
	hex
	default 0x00800000

config BOARDINFO
	default "Canon EOS 600D"

endif
```

## arch/arm/boards/canon-a1100/Kconfig
```kconfig
if MACH_CANON_A1100

config ARCH_TEXT_BASE
	hex
	default 0x00001900

config BOARDINFO
	default "Canon PowerShot A1100 IS"

endif
```

## arch/arm/configs/canon-600d_defconfig
```kconfig
CONFIG_BUILTIN_DTB=y
CONFIG_BUILTIN_DTB_NAME="canon-600d"
CONFIG_ARCH_DIGIC=y
CONFIG_MACH_CANON_600D=y
CONFIG_ARM_OPTIMZED_STRING_FUNCTIONS=y
CONFIG_PBL_IMAGE=y
CONFIG_IMAGE_COMPRESSION_LZ4=y
CONFIG_TEXT_BASE=0x00300000
CONFIG_MALLOC_SIZE=0x200000
CONFIG_PROMPT="canon> "
CONFIG_LONGHELP=y
CONFIG_GLOB=y
CONFIG_HUSH_FANCY_PROMPT=y
CONFIG_HUSH_GETOPT=y
CONFIG_CMDLINE_EDITING=y
CONFIG_AUTO_COMPLETE=y
CONFIG_DEFAULT_ENVIRONMENT_PATH="arch/arm/boards/canon-600d/env"
CONFIG_DEBUG_LL=y
CONFIG_CMD_EDIT=y
CONFIG_CMD_SLEEP=y
CONFIG_CMD_MSLEEP=y
CONFIG_CMD_EXPORT=y
CONFIG_CMD_LET=y
CONFIG_CMD_GLOBAL=y
# CONFIG_CMD_RM is not set
# CONFIG_CMD_MKDIR is not set
# CONFIG_CMD_RMDIR is not set
# CONFIG_CMD_PWD is not set
# CONFIG_CMD_MOUNT is not set
# CONFIG_CMD_UMOUNT is not set
# CONFIG_CMD_CLEAR is not set
CONFIG_CMD_ECHO_E=y
CONFIG_CMD_LOADY=y
CONFIG_CMD_MEMINFO=y
CONFIG_CMD_IOMEM=y
CONFIG_CMD_MM=y
# CONFIG_CMD_BOOTM is not set
# CONFIG_CMD_BOOTU is not set
CONFIG_CMD_GO=y
CONFIG_CMD_OFTREE=y
CONFIG_CMD_OF_PROPERTY=y
CONFIG_CMD_OF_NODE=y
CONFIG_CMD_GPIO=y
CONFIG_CMD_LED=y
CONFIG_OFDEVICE=y
CONFIG_OF_BAREBOX_DRIVERS=y
CONFIG_DRIVER_SERIAL_DIGIC=y
# CONFIG_SPI is not set
CONFIG_LED=y
CONFIG_LED_GPIO=y
CONFIG_LED_GPIO_OF=y
CONFIG_GPIO_DIGIC=y
CONFIG_ZLIB=y
```

## arch/arm/configs/canon-a1100_defconfig
```kconfig
CONFIG_ARCH_DIGIC=y
CONFIG_MACH_CANON_A1100=y
CONFIG_ARM_OPTIMZED_STRING_FUNCTIONS=y
CONFIG_PBL_IMAGE=y
CONFIG_PBL_RELOCATABLE=y
CONFIG_IMAGE_COMPRESSION_LZ4=y
CONFIG_TEXT_BASE=0x00300000
CONFIG_MALLOC_SIZE=0x200000
CONFIG_PANIC_HANG=y
CONFIG_PROMPT="canon> "
CONFIG_LONGHELP=y
CONFIG_GLOB=y
CONFIG_HUSH_FANCY_PROMPT=y
CONFIG_HUSH_GETOPT=y
CONFIG_CMDLINE_EDITING=y
CONFIG_AUTO_COMPLETE=y
CONFIG_DEFAULT_ENVIRONMENT_PATH="arch/arm/boards/canon-a1100/env"
CONFIG_DEBUG_LL=y
CONFIG_CMD_SLEEP=y
CONFIG_CMD_GLOBAL=y
# CONFIG_CMD_RM is not set
# CONFIG_CMD_MKDIR is not set
# CONFIG_CMD_RMDIR is not set
# CONFIG_CMD_PWD is not set
# CONFIG_CMD_MOUNT is not set
# CONFIG_CMD_UMOUNT is not set
# CONFIG_CMD_CLEAR is not set
CONFIG_CMD_ECHO_E=y
CONFIG_CMD_IOMEM=y
# CONFIG_CMD_MEMCMP is not set
# CONFIG_CMD_MEMCPY is not set
# CONFIG_CMD_MEMSET is not set
# CONFIG_CMD_BOOTM is not set
# CONFIG_CMD_BOOTU is not set
# CONFIG_CMD_TEST is not set
# CONFIG_CMD_VERSION is not set
# CONFIG_CMD_HELP is not set
# CONFIG_CMD_DEVINFO is not set
# CONFIG_SPI is not set
CONFIG_ZLIB=y
```

## arch/arm/configs/ezzy-4_defconfig
```kconfig
CONFIG_TEXT_BASE=0x14300000
CONFIG_ARCH_SC6531E=y
CONFIG_ARM_OPTIMZED_STRING_FUNCTIONS=y
CONFIG_PBL_IMAGE=y
CONFIG_IMAGE_COMPRESSION_NONE=y
CONFIG_MALLOC_SIZE=0x100000
CONFIG_PROMPT="ezzy-4 > "
CONFIG_HUSH_FANCY_PROMPT=y
CONFIG_CMDLINE_EDITING=y
CONFIG_AUTO_COMPLETE=y
CONFIG_DEFAULT_ENVIRONMENT_GENERIC_NEW=y
CONFIG_DEFAULT_ENVIRONMENT_PATH="arch/arm/boards/ezzy-4/env"
CONFIG_DEBUG_LL=y
CONFIG_DEBUG_INITCALLS=y
CONFIG_DEBUG_PBL=y
CONFIG_CMD_IOMEM=y
CONFIG_CMD_MEMINFO=y
# CONFIG_CMD_BOOTM is not set
# CONFIG_CMD_BOOTU is not set
CONFIG_CMD_GO=y
# CONFIG_CMD_MOUNT is not set
# CONFIG_CMD_UMOUNT is not set
CONFIG_CMD_EXPORT=y
CONFIG_CMD_MD5SUM=y
# CONFIG_CMD_PWD is not set
CONFIG_CMD_SHA1SUM=y
CONFIG_CMD_LET=y
CONFIG_CMD_MSLEEP=y
CONFIG_CMD_SLEEP=y
# CONFIG_CMD_CLEAR is not set
CONFIG_CMD_ECHO_E=y
CONFIG_CMD_EDIT=y
CONFIG_CMD_TIMEOUT=y
CONFIG_CMD_MEMTEST=y
CONFIG_CMD_MM=y
CONFIG_CMD_GPIO=y
CONFIG_CMD_LED=y
CONFIG_CMD_OF_NODE=y
CONFIG_CMD_OF_PROPERTY=y
CONFIG_CMD_OFTREE=y
CONFIG_CMD_TIME=y
CONFIG_CMD_UPTIME=y
CONFIG_OFDEVICE=y
# CONFIG_SPI is not set
CONFIG_CLOCKSOURCE_DUMMY_RATE=2000
CONFIG_LED=y
CONFIG_LED_GPIO=y
CONFIG_LED_GPIO_OF=y
CONFIG_ZLIB=y
```

## arch/arm/configs/stm32mp_defconfig
```kconfig
CONFIG_ARCH_STM32MP=y
CONFIG_THUMB2_BAREBOX=y
# CONFIG_ARM_EXCEPTIONS is not set
CONFIG_ARM_UNWIND=y
CONFIG_MMU=y
CONFIG_MALLOC_SIZE=0x0
CONFIG_MALLOC_TLSF=y
CONFIG_KALLSYMS=y
CONFIG_HUSH_FANCY_PROMPT=y
CONFIG_CMDLINE_EDITING=y
CONFIG_AUTO_COMPLETE=y
CONFIG_BLSPEC=y
CONFIG_CONSOLE_ACTIVATE_NONE=y
CONFIG_CONSOLE_ALLOW_COLOR=y
CONFIG_PBL_CONSOLE=y
CONFIG_DEFAULT_ENVIRONMENT_GENERIC_NEW=y
CONFIG_RESET_SOURCE=y
# CONFIG_CMD_ARM_CPUINFO is not set
# CONFIG_CMD_DEVINFO is not set
# CONFIG_CMD_DRVINFO is not set
# CONFIG_CMD_HELP is not set
# CONFIG_CMD_VERSION is not set
# CONFIG_CMD_BOOTM is not set
# CONFIG_CMD_BOOTU is not set
# CONFIG_CMD_MOUNT is not set
# CONFIG_CMD_UMOUNT is not set
# CONFIG_CMD_CAT is not set
# CONFIG_CMD_CD is not set
# CONFIG_CMD_CP is not set
# CONFIG_CMD_PWD is not set
# CONFIG_CMD_RM is not set
# CONFIG_CMD_RMDIR is not set
# CONFIG_CMD_FALSE is not set
# CONFIG_CMD_TRUE is not set
# CONFIG_CMD_CLEAR is not set
# CONFIG_CMD_ECHO is not set
# CONFIG_CMD_MD is not set
# CONFIG_CMD_MEMCMP is not set
# CONFIG_CMD_MEMCPY is not set
# CONFIG_CMD_MEMSET is not set
# CONFIG_CMD_MW is not set
CONFIG_DEV_MEM=y
CONFIG_PINCTRL=y
CONFIG_ZLIB=y
CONFIG_CRC8=y
```

## arch/arm/mach-digic/Kconfig
```kconfig
if ARCH_DIGIC

choice
	prompt "camera type"

config MACH_CANON_A1100
	bool "Canon PowerShot A1100 IS"
	select DIGIC_CSRC_TIMER

config MACH_CANON_600D
	bool "Canon EOS 600D"
	select DIGIC_CSRC_DUMMY

endchoice

config ARCH_TEXT_BASE
	hex
	default 0x00001900 if MACH_CANON_A1100
	default 0x00800000 if MACH_CANON_600D


config DIGIC_CSRC_TIMER
	bool

config DIGIC_CSRC_DUMMY
	bool

endif
```

## arch/arm/mach-sc6531e/Kconfig
```kconfig
# SPDX-License-Identifier: GPL-2.0-only

if ARCH_SC6531E

choice
	prompt "board type"

config MACH_EZZY4
	bool "F+ Ezzy 4"

endchoice

config ARCH_TEXT_BASE
	hex
	default 0x00001900 if MACH_EZZY4

endif
```

## arch/mips/boards/ainol-novo7-paladin/Kconfig
```kconfig
if BOARD_AINOL_NOVO7_PALADIN

config BOARDINFO
	default "Ainol Novo7 Paladin"

endif
```

## arch/mips/boards/qemu-malta/env/malta_be_defconfig
```kconfig
CONFIG_MIPS_MALTA=y
CONFIG_CPU_MIPS32_R2=y
CONFIG_PAGE_SIZE_16KB=y
CONFIG_MIPS_MT_SMP=y
CONFIG_NR_CPUS=8
CONFIG_HZ_100=y
CONFIG_SYSVIPC=y
CONFIG_NO_HZ=y
CONFIG_HIGH_RES_TIMERS=y
CONFIG_LOG_BUF_SHIFT=15
CONFIG_RELAY=y
# CONFIG_COMPAT_BRK is not set
CONFIG_SLAB=y
CONFIG_PCI=y
CONFIG_NET=y
CONFIG_PACKET=y
CONFIG_UNIX=y
CONFIG_XFRM_USER=y
CONFIG_NET_KEY=y
CONFIG_NET_KEY_MIGRATE=y
CONFIG_INET=y
CONFIG_IP_MULTICAST=y
CONFIG_IP_ADVANCED_ROUTER=y
CONFIG_IP_MULTIPLE_TABLES=y
CONFIG_IP_ROUTE_MULTIPATH=y
CONFIG_IP_ROUTE_VERBOSE=y
CONFIG_IP_MROUTE=y
CONFIG_IP_PIMSM_V1=y
CONFIG_IP_PIMSM_V2=y
CONFIG_SYN_COOKIES=y
CONFIG_INET_AH=y
CONFIG_INET_ESP=y
CONFIG_INET_IPCOMP=y
CONFIG_TCP_MD5SIG=y
# CONFIG_IPV6 is not set
# CONFIG_WIRELESS is not set
CONFIG_UEVENT_HELPER_PATH="/sbin/hotplug"
CONFIG_DEVTMPFS=y
CONFIG_CONNECTOR=y
CONFIG_MTD=y
CONFIG_MTD_BLOCK=y
CONFIG_MTD_OOPS=y
CONFIG_MTD_CFI=y
CONFIG_MTD_CFI_INTELEXT=y
CONFIG_MTD_CFI_AMDSTD=y
CONFIG_MTD_CFI_STAA=y
CONFIG_MTD_PHYSMAP=y
CONFIG_MTD_UBI=y
CONFIG_MTD_UBI_GLUEBI=y
CONFIG_BLK_DEV_FD=y
CONFIG_BLK_DEV_UMEM=y
CONFIG_BLK_DEV_LOOP=y
CONFIG_BLK_DEV_CRYPTOLOOP=y
CONFIG_BLK_DEV_NBD=y
CONFIG_BLK_DEV_RAM=y
CONFIG_RAID_ATTRS=y
CONFIG_BLK_DEV_SD=y
CONFIG_CHR_DEV_ST=y
CONFIG_CHR_DEV_OSST=y
CONFIG_BLK_DEV_SR=y
CONFIG_BLK_DEV_SR_VENDOR=y
CONFIG_CHR_DEV_SG=y
CONFIG_SCSI_CONSTANTS=y
CONFIG_SCSI_LOGGING=y
CONFIG_SCSI_SCAN_ASYNC=y
CONFIG_SCSI_FC_ATTRS=y
CONFIG_ISCSI_TCP=y
CONFIG_BLK_DEV_3W_XXXX_RAID=y
CONFIG_SCSI_3W_9XXX=y
CONFIG_SCSI_ACARD=y
CONFIG_SCSI_AIC7XXX=y
CONFIG_AIC7XXX_RESET_DELAY_MS=15000
# CONFIG_AIC7XXX_DEBUG_ENABLE is not set
CONFIG_ATA=y
CONFIG_ATA_PIIX=y
CONFIG_PATA_LEGACY=y
CONFIG_MD=y
CONFIG_BLK_DEV_MD=y
CONFIG_MD_LINEAR=y
CONFIG_MD_MULTIPATH=y
CONFIG_MD_FAULTY=y
CONFIG_BLK_DEV_DM=y
CONFIG_DM_CRYPT=y
CONFIG_DM_SNAPSHOT=y
CONFIG_DM_MIRROR=y
CONFIG_DM_ZERO=y
CONFIG_DM_MULTIPATH=y
CONFIG_NETDEVICES=y
CONFIG_BONDING=y
CONFIG_DUMMY=y
CONFIG_EQUALIZER=y
CONFIG_MACVLAN=y
CONFIG_TUN=y
CONFIG_VETH=y
# CONFIG_NET_VENDOR_3COM is not set
CONFIG_PCNET32=y
CONFIG_CHELSIO_T3=y
CONFIG_AX88796=y
CONFIG_NETXEN_NIC=y
CONFIG_TC35815=y
CONFIG_BROADCOM_PHY=y
CONFIG_CICADA_PHY=y
CONFIG_DAVICOM_PHY=y
CONFIG_ICPLUS_PHY=y
CONFIG_LXT_PHY=y
CONFIG_MARVELL_PHY=y
CONFIG_QSEMI_PHY=y
CONFIG_REALTEK_PHY=y
CONFIG_SMSC_PHY=y
CONFIG_VITESSE_PHY=y
# CONFIG_WLAN is not set
# CONFIG_INPUT_KEYBOARD is not set
# CONFIG_INPUT_MOUSE is not set
# CONFIG_SERIO_I8042 is not set
CONFIG_VT_HW_CONSOLE_BINDING=y
CONFIG_SERIAL_8250=y
CONFIG_SERIAL_8250_CONSOLE=y
# CONFIG_HWMON is not set
# CONFIG_VGA_CONSOLE is not set
# CONFIG_HID is not set
CONFIG_UIO=y
CONFIG_UIO_CIF=y
CONFIG_EXT2_FS=y
CONFIG_EXT3_FS=y
CONFIG_PROC_KCORE=y
CONFIG_TMPFS=y
# CONFIG_NETWORK_FILESYSTEMS is not set
CONFIG_NLS=y
CONFIG_DEBUG_KERNEL=y
# CONFIG_FTRACE is not set
CONFIG_CRYPTO_CRYPTD=y
CONFIG_CRYPTO_CCM=y
CONFIG_CRYPTO_GCM=y
CONFIG_CRYPTO_ECB=y
CONFIG_CRYPTO_LRW=y
CONFIG_CRYPTO_PCBC=y
CONFIG_CRYPTO_XCBC=y
CONFIG_CRYPTO_MD4=y
CONFIG_CRYPTO_MICHAEL_MIC=y
CONFIG_CRYPTO_SHA512=y
CONFIG_CRYPTO_TGR192=y
CONFIG_CRYPTO_WP512=y
CONFIG_CRYPTO_ANUBIS=y
CONFIG_CRYPTO_ARC4=y
CONFIG_CRYPTO_BLOWFISH=y
CONFIG_CRYPTO_CAMELLIA=y
CONFIG_CRYPTO_CAST5=y
CONFIG_CRYPTO_CAST6=y
CONFIG_CRYPTO_FCRYPT=y
CONFIG_CRYPTO_KHAZAD=y
CONFIG_CRYPTO_SERPENT=y
CONFIG_CRYPTO_TEA=y
CONFIG_CRYPTO_TWOFISH=y
CONFIG_CRC_ITU_T=y
CONFIG_LIBCRC32C=y
```

## arch/mips/configs/ainol-novo7-paladin_defconfig
```kconfig
CONFIG_BUILTIN_DTB=y
CONFIG_BUILTIN_DTB_NAME="ainol-novo7-paladin"
CONFIG_MACH_MIPS_XBURST=y
CONFIG_BOARD_AINOL_NOVO7_PALADIN=y
CONFIG_JZ47XX_DEBUG_LL_UART2=y
CONFIG_EXPERIMENTAL=y
CONFIG_BAUDRATE=57600
CONFIG_GLOB=y
CONFIG_HUSH_FANCY_PROMPT=y
CONFIG_CMDLINE_EDITING=y
CONFIG_AUTO_COMPLETE=y
# CONFIG_DEFAULT_ENVIRONMENT is not set
CONFIG_DEBUG_LL=y
CONFIG_LONGHELP=y
CONFIG_CMD_IOMEM=y
CONFIG_CMD_MEMINFO=y
CONFIG_CMD_BOOTM_SHOW_TYPE=y
CONFIG_CMD_BOOTM_VERBOSE=y
CONFIG_CMD_BOOTM_INITRD=y
CONFIG_CMD_BOOTM_OFTREE=y
CONFIG_CMD_BOOTM_OFTREE_UIMAGE=y
CONFIG_CMD_GO=y
CONFIG_CMD_LOADB=y
CONFIG_CMD_LOADS=y
CONFIG_CMD_LOADY=y
CONFIG_CMD_RESET=y
CONFIG_CMD_SAVES=y
CONFIG_CMD_UIMAGE=y
CONFIG_CMD_GLOBAL=y
CONFIG_CMD_FILETYPE=y
CONFIG_CMD_MD5SUM=y
CONFIG_CMD_SLEEP=y
CONFIG_CMD_EDIT=y
CONFIG_CMD_GPIO=y
CONFIG_OFDEVICE=y
# CONFIG_SPI is not set
CONFIG_CLOCKSOURCE_DUMMY_RATE=16000
CONFIG_GPIO_JZ4740=y
# CONFIG_PINCTRL is not set
CONFIG_SHA1=y
CONFIG_SHA224=y
CONFIG_SHA256=y
```

## arch/mips/configs/black-swift_defconfig
```kconfig
CONFIG_BUILTIN_DTB=y
CONFIG_BUILTIN_DTB_NAME="black-swift"
CONFIG_MACH_MIPS_ATH79=y
CONFIG_BOARD_BLACK_SWIFT=y
CONFIG_PBL_IMAGE=y
CONFIG_IMAGE_COMPRESSION_XZKERN=y
CONFIG_MMU=y
CONFIG_TEXT_BASE=0x83000000
CONFIG_MALLOC_SIZE=0x1000000
CONFIG_MALLOC_TLSF=y
CONFIG_CMDLINE_EDITING=y
CONFIG_AUTO_COMPLETE=y
CONFIG_PBL_CONSOLE=y
CONFIG_PARTITION=y
CONFIG_DEFAULT_ENVIRONMENT_GENERIC_NEW=y
CONFIG_DEFAULT_ENVIRONMENT_PATH="arch/mips/boards/black-swift/env"
CONFIG_DEBUG_INFO=y
CONFIG_DEBUG_LL=y
CONFIG_LONGHELP=y
CONFIG_CMD_IOMEM=y
CONFIG_CMD_IMD=y
CONFIG_CMD_MEMINFO=y
# CONFIG_CMD_BOOTM is not set
CONFIG_CMD_GO=y
CONFIG_CMD_LOADB=y
CONFIG_CMD_LOADY=y
CONFIG_CMD_RESET=y
CONFIG_CMD_PARTITION=y
CONFIG_CMD_EXPORT=y
CONFIG_CMD_LOADENV=y
CONFIG_CMD_PRINTENV=y
CONFIG_CMD_MAGICVAR=y
CONFIG_CMD_MAGICVAR_HELP=y
CONFIG_CMD_SAVEENV=y
CONFIG_CMD_SHA1SUM=y
CONFIG_CMD_LET=y
CONFIG_CMD_SLEEP=y
CONFIG_CMD_DHCP=y
CONFIG_CMD_HOST=y
CONFIG_CMD_MIITOOL=y
CONFIG_CMD_PING=y
CONFIG_CMD_TFTP=y
CONFIG_CMD_ECHO_E=y
CONFIG_CMD_EDIT=y
CONFIG_CMD_READLINE=y
CONFIG_CMD_TIMEOUT=y
CONFIG_CMD_MM=y
CONFIG_CMD_CLK=y
CONFIG_CMD_FLASH=y
CONFIG_CMD_GPIO=y
CONFIG_CMD_SPI=y
CONFIG_CMD_OF_NODE=y
CONFIG_CMD_OF_PROPERTY=y
CONFIG_CMD_OFTREE=y
CONFIG_CMD_TIME=y
CONFIG_NET=y
CONFIG_NET_NFS=y
CONFIG_NET_NETCONSOLE=y
CONFIG_OFDEVICE=y
CONFIG_DRIVER_SERIAL_AR933X=y
CONFIG_DRIVER_NET_AG71XX=y
CONFIG_DRIVER_SPI_ATH79=y
CONFIG_MTD=y
# CONFIG_MTD_OOB_DEVICE is not set
CONFIG_MTD_M25P80=y
CONFIG_FS_TFTP=y
CONFIG_FS_NFS=y
CONFIG_DIGEST_SHA224_GENERIC=y
CONFIG_DIGEST_SHA256_GENERIC=y
```

## arch/mips/configs/ralink_defconfig
```kconfig
CONFIG_MACH_MIPS_RALINK=y
CONFIG_BOARD_WRTNODE2R=y
CONFIG_BOARD_LINKIT=y
CONFIG_BOARD_OMEGA2=y
CONFIG_IMAGE_COMPRESSION_XZKERN=y
CONFIG_MMU=y
CONFIG_TEXT_BASE=0x83000000
CONFIG_MALLOC_TLSF=y
CONFIG_GLOB=y
CONFIG_GLOB_SORT=y
CONFIG_CMDLINE_EDITING=y
CONFIG_AUTO_COMPLETE=y
CONFIG_FLEXIBLE_BOOTARGS=y
CONFIG_PBL_CONSOLE=y
CONFIG_PARTITION=y
# CONFIG_DEFAULT_ENVIRONMENT is not set
CONFIG_CMD_DMESG=y
CONFIG_LONGHELP=y
CONFIG_CMD_IOMEM=y
CONFIG_CMD_IMD=y
CONFIG_CMD_MEMINFO=y
CONFIG_CMD_BOOT=y
# CONFIG_CMD_BOOTM is not set
CONFIG_CMD_GO=y
CONFIG_CMD_LOADB=y
CONFIG_CMD_LOADY=y
CONFIG_CMD_RESET=y
CONFIG_CMD_PARTITION=y
CONFIG_CMD_AUTOMOUNT=y
CONFIG_CMD_NV=y
CONFIG_CMD_EXPORT=y
CONFIG_CMD_GLOBAL=y
CONFIG_CMD_LOADENV=y
CONFIG_CMD_PRINTENV=y
CONFIG_CMD_MAGICVAR=y
CONFIG_CMD_MAGICVAR_HELP=y
CONFIG_CMD_SAVEENV=y
CONFIG_CMD_BASENAME=y
CONFIG_CMD_DIRNAME=y
CONFIG_CMD_READLINK=y
CONFIG_CMD_SHA1SUM=y
CONFIG_CMD_GETOPT=y
CONFIG_CMD_LET=y
CONFIG_CMD_SLEEP=y
CONFIG_CMD_ECHO_E=y
CONFIG_CMD_EDIT=y
CONFIG_CMD_READLINE=y
CONFIG_CMD_TIMEOUT=y
CONFIG_CMD_MM=y
CONFIG_CMD_CLK=y
CONFIG_CMD_FLASH=y
CONFIG_CMD_GPIO=y
CONFIG_CMD_SPI=y
CONFIG_CMD_OF_NODE=y
CONFIG_CMD_OF_PROPERTY=y
CONFIG_CMD_OFTREE=y
CONFIG_CMD_TIME=y
CONFIG_OFDEVICE=y
CONFIG_OF_BAREBOX_DRIVERS=y
CONFIG_DRIVER_SPI_MT7621=y
CONFIG_MTD=y
# CONFIG_MTD_OOB_DEVICE is not set
CONFIG_MTD_M25P80=y
CONFIG_PINCTRL_SINGLE=y
```

## arch/mips/configs/tplink-mr3020_defconfig
```kconfig
CONFIG_BUILTIN_DTB=y
CONFIG_BUILTIN_DTB_NAME="tplink-mr3020"
CONFIG_MACH_MIPS_ATH79=y
CONFIG_CMDLINE_EDITING=y
CONFIG_AUTO_COMPLETE=y
CONFIG_LONGHELP=y
CONFIG_CMD_IOMEM=y
CONFIG_CMD_MEMINFO=y
# CONFIG_CMD_BOOTM is not set
CONFIG_CMD_GO=y
CONFIG_CMD_LOADB=y
CONFIG_CMD_LOADY=y
CONFIG_CMD_RESET=y
CONFIG_CMD_GLOBAL=y
CONFIG_CMD_SHA1SUM=y
CONFIG_CMD_LET=y
CONFIG_CMD_SLEEP=y
CONFIG_CMD_DHCP=y
CONFIG_CMD_HOST=y
CONFIG_NET_CMD_IFUP=y
CONFIG_CMD_MIITOOL=y
CONFIG_CMD_PING=y
CONFIG_CMD_TFTP=y
CONFIG_CMD_EDIT=y
CONFIG_CMD_MM=y
CONFIG_CMD_CLK=y
CONFIG_CMD_FLASH=y
CONFIG_CMD_SPI=y
CONFIG_CMD_OF_NODE=y
CONFIG_CMD_OF_PROPERTY=y
CONFIG_CMD_OFTREE=y
CONFIG_NET=y
CONFIG_NET_NFS=y
CONFIG_NET_NETCONSOLE=y
CONFIG_OFDEVICE=y
CONFIG_DRIVER_SERIAL_AR933X=y
CONFIG_NET_USB=y
CONFIG_NET_USB_ASIX=y
CONFIG_NET_USB_SMSC95XX=y
CONFIG_DRIVER_SPI_ATH79=y
CONFIG_MTD=y
# CONFIG_MTD_OOB_DEVICE is not set
CONFIG_MTD_M25P80=y
CONFIG_USB_STORAGE=y
CONFIG_FS_EXT4=y
CONFIG_FS_TFTP=y
CONFIG_FS_NFS=y
CONFIG_FS_FAT=y
CONFIG_FS_FAT_LFN=y
CONFIG_DIGEST_SHA224_GENERIC=y
CONFIG_DIGEST_SHA256_GENERIC=y
```

## arch/mips/configs/tplink-wr720n_defconfig
```kconfig
CONFIG_MACH_MIPS_AR9331=y
CONFIG_TEXT_BASE=0xa0800000
CONFIG_STACK_SIZE=0x20000
CONFIG_CMDLINE_EDITING=y
CONFIG_AUTO_COMPLETE=y
CONFIG_CMD_EDIT=y
CONFIG_CMD_SLEEP=y
CONFIG_CMD_LET=y
CONFIG_CMD_LOADB=y
CONFIG_CMD_LOADY=y
CONFIG_CMD_MEMINFO=y
CONFIG_CMD_IOMEM=y
CONFIG_CMD_MM=y
CONFIG_CMD_SHA1SUM=y
CONFIG_CMD_RESET=y
CONFIG_CMD_GO=y
CONFIG_CMD_SPI=y
CONFIG_DRIVER_SERIAL_AR933X=y
CONFIG_DRIVER_SPI_ATH933X=y
CONFIG_MTD=y
CONFIG_MTD_M25P80=y
CONFIG_MD5=y
CONFIG_SHA224=y
CONFIG_SHA256=y
```

## arch/mips/mach-ar531x/Kconfig
```kconfig
if MACH_MIPS_AR531X

config ARCH_TEXT_BASE
	hex
	default 0xa0800000

choice
	prompt "Board type"

config BOARD_NETGEAR_WG102
	bool "Netgear WG102"

endchoice

source arch/mips/boards/netgear-wg102/Kconfig

endif
```

## arch/mips/mach-ar9331/Kconfig
```kconfig
if MACH_MIPS_AR9331

config ARCH_TEXT_BASE
	hex
	default 0xa0800000

choice
	prompt "Board type"

config BOARD_TPLINK_WR720N
	bool "TP-LINK WR720N"
	select HAVE_PBL_IMAGE
	select HAVE_IMAGE_COMPRESSION
endchoice

endif

source arch/mips/boards/tplink-wr720n/Kconfig
```

## arch/mips/mach-malta/Kconfig
```kconfig
if MACH_MIPS_MALTA

choice
	prompt "Board type"

config BOARD_QEMU_MALTA
	bool "qemu malta"
	select HAVE_PBL_IMAGE
	select HAVE_IMAGE_COMPRESSION
	select HAS_NMON

endchoice

endif
```
