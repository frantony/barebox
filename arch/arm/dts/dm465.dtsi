#include "skeleton.dtsi"

/ {
	soc {
		compatible = "simple-bus";
		model = "dm465";
		#address-cells = <1>;
		#size-cells = <1>;
		ranges = <0x0 0x01c00000 0x400000>;

		serial0: serial@1c20000 {
			compatible = "ns16550a";
			reg = <0x20000 0x400>;
			reg-shift = <2>;
			clock-frequency = <24000000>;
			status = "disabled";
		};
	};
};
