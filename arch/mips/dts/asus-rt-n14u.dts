/dts-v1/;

/include/ "skeleton.dtsi"

/ {
	model = "ASUS RT-N14U";
	compatible = "asus,rt-n14u";

	memory {
		reg = <0x00000000 0x04000000>;
	};

	uartlite@10000c00 {
		compatible = "ralink,mt7620a-uart", "ralink,rt2880-uart", "ns16550a";
		reg = <0x10000c00 0x100>;

		reg-shift = <2>;
		clock-frequency = <39628800>;
		status = "okay";
	};
};
