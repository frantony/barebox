/*
 * Ainol Novo7 Paladin device tree
 *
 * Copyright (c) 2015 Antony Pavlov <antonynpavlov@gmail.com>
 *
 * This program is free software; you can redistribute it and/or
 * modify it under the terms of the GNU General Public License as
 * published by the Free Software Foundation; either version 2 of
 * the License, or (at your option) any later version.
 *
 * This program is distributed in the hope that it will be useful,
 * but WITHOUT ANY WARRANTY; without even the implied warranty of
 * MERCHANTABILITY or FITNESS FOR A PARTICULAR PURPOSE.  See the
 * GNU General Public License for more details.
 *
 */

/dts-v1/;

#include "jz4770.dtsi"

/ {
	model = "Ainol Novo7 Paladin";
	compatible = "ainol,novo7-paladin";

	memory {
		device_type = "memory";
		reg = <0x0 0x10000000>;
	};
};

&uart2 {
	status = "okay";
};
